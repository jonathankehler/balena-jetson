## layers/meta-balena-jetson/conf/machine/rogue-agx101.conf
```bitbake
#@TYPE: Machine
##@NAME: rogue-agx101
##@DESCRIPTION: Machine configuration for the CTI Rogue AGX101 Carrier Board for NVidia Jetson Xavier

MACHINEOVERRIDES = "jetson-xavier:${MACHINE}"
KERNEL_DEVICETREE ?= "_ddot_/_ddot_/_ddot_/_ddot_/nvidia/platform/t19x/galen/kernel-dts/tegra194-agx-cti-AGX101-IMX577-6CAM.dtb"

include conf/machine/jetson-xavier.conf
```
